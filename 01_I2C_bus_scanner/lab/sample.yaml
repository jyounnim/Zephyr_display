## 01_I2C_bus_scanner/lab/sample.yaml
```yaml
sample:
  description: Scan I2C0 for connected devices once at boot, from a dedicated thread
  name: i2c_bus_scanner
common:
  tags:
    - i2c
tests:
  sample.i2c.bus_scanner:
    platform_allow:
      - sr100_rdk/sr100/m55
    harness: console
    harness_config:
      type: one_line
      regex:
        - "=== I2C Bus Scanner \\(SR110\\) ==="
```

## 02_I2C_LCD_LAB/lab/sample.yaml
```yaml
sample:
  name: I2C LCD (PCF8574 + HD44780) lab
  description: >
    Drive a 16x2 HD44780 character LCD through a PCF8574/PCF8574A I2C
    backpack using a raw I2C "LiquidCrystal_I2C"-style driver (no
    Zephyr Display/CFB subsystem).
common:
  tags:
    - i2c
    - display
  platform_allow:
    - sr100_rdk/sr100/m55
  harness: console
  harness_config:
    type: one_line
    regex:
      - "LCD initialized and .* written"
tests:
  sample.i2c.pcf8574_hd44780_lcd:
    build_only: true
```

## 04_SPI_basics/lab/sample.yaml
```yaml
sample:
  name: SPI basics - bus loopback self-test
  description: >
    Verify the SPI0 peripheral, clock, and pin routing on the Synaptics
    SR110 (sr100_rdk/sr100/m55) using a physical MOSI-MISO jumper wire
    loopback (SR110 has no ESP32-style software GPIO-matrix trick, so a
    real jumper wire is required here).
common:
  tags:
    - spi
  platform_allow:
    - sr100_rdk/sr100/m55
  harness: console
  harness_config:
    type: one_line
    regex:
      - "PASS: received bytes match sent bytes.*"
tests:
  sample.spi.sr110_loopback:
    build_only: true
```

## 05_OLED_SSD1306_SPI/lab/sample.yaml
```yaml
sample:
  description: 0.96" SSD1306 OLED over SPI, updated from a dedicated thread
  name: oled_ssd1306_spi
common:
  tags:
    - display
    - spi
tests:
  sample.display.ssd1306_spi:
    platform_allow:
      - sr100_rdk/sr100/m55
    harness: console
    harness_config:
      type: one_line
      regex:
        - "DisplayThread: ready \\(SPI mode\\)"
```

## 06_TFT_ST7789V3/lab/sample.yaml
```yaml
sample:
  description: >
    Draw color bars and "Hello World!" on a 1.69" 240x280 ST7789V3 SPI
    TFT panel on the Synaptics SR110 (sr100_rdk/sr100/m55) using raw
    SPI writes (no Zephyr display driver).
  name: tft_st7789v3
common:
  tags:
    - spi
    - display
tests:
  sample.display.st7789v3:
    platform_allow:
      - sr100_rdk/sr100/m55
    harness: console
    harness_config:
      type: one_line
      regex:
        - "=== TFT ST7789V3 \\(SPI, 240x280\\) ==="
```

## 07_Nokia5110_display/lab/sample.yaml
```yaml
sample:
  name: Nokia 5110 (PCD8544) LCD - raw SPI
  description: >
    Drive an 84x48 PCD8544-based Nokia 5110 monochrome LCD over raw SPI
    (MOSI/SCLK/CS + separate RST/DC GPIOs), without the Zephyr
    Display/CFB subsystem.
common:
  tags:
    - spi
    - display
  platform_allow:
    - sr100_rdk/sr100/m55
  harness: console
  harness_config:
    type: one_line
    regex:
      - "Nokia 5110 initialized and .* written"
tests:
  sample.spi.nokia5110_pcd8544:
    build_only: true
```

## 08_TFT_ST7735/lab/sample.yaml
```yaml
sample:
  name: ST7735 128x160 color TFT - raw SPI
  description: >
    Drive an ST7735 "green tab" 128x160 color TFT over raw SPI
    (MOSI/SCLK/CS + separate RST/DC GPIOs), without the Zephyr
    Display/CFB subsystem. Draws text plus an R/G/B/Y/M/C/W color-bar
    diagnostic.
common:
  tags:
    - spi
    - display
  platform_allow:
    - sr100_rdk/sr100/m55
  harness: console
  harness_config:
    type: one_line
    regex:
      - "ST7735 initialized and .* drawn"
tests:
  sample.spi.st7735_tft:
    build_only: true
```
